/*
 * Copyright (c) 2020 Pete Johanson
 *
 * SPDX-License-Identifier: MIT
 */

#include "rekdactyl.dtsi"


&kscan0 {
	col-gpios
		= <&pro_micro_b 3 GPIO_ACTIVE_HIGH>
		, <&pro_micro_b 1 GPIO_ACTIVE_HIGH>
		, <&pro_micro_f 7 GPIO_ACTIVE_HIGH>
		, <&pro_micro_f 6 GPIO_ACTIVE_HIGH>
		, <&pro_micro_f 5 GPIO_ACTIVE_HIGH>
		;
};
